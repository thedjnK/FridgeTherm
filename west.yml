## west.yml
```yaml
manifest:
  remotes:
    - name: zephyr
      url-base: https://github.com/zephyrproject-rtos
    - name: thedjnK
      url-base: https://github.com/thedjnK

  projects:
    - name: zephyr
      remote: zephyr
      revision: main
      import:
        name-allowlist:
          - cmsis
          - hal_nordic
          - mcuboot
          - tinycrypt
          - zcbor
    - name: boards
      remote: thedjnK
      revision: main

  self:
    path: fridge_therm
```
