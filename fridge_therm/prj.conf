## CMakeLists.txt
```
#
# Copyright (C) 2024 Jamie M.
#
# SPDX-License-Identifier: Apache-2.0
#

cmake_minimum_required(VERSION 3.20.0)

if(NOT SYSBUILD)
  message(FATAL_ERROR "This project requires sysbuild")
endif()

find_package(Zephyr REQUIRED HINTS $ENV{ZEPHYR_BASE})
project(fridge_therm)

target_sources(app PRIVATE src/main.c)
```

## sysbuild.conf
```
#
# Copyright (C) 2024 Jamie M.
#
# SPDX-License-Identifier: Apache-2.0
#

SB_CONFIG_BOOTLOADER_MCUBOOT=y
SB_CONFIG_BOOT_SIGNATURE_TYPE_ECDSA_P256=y
```

## prj.conf
```kconfig
#
# Copyright (C) 2024 Jamie M.
#
# SPDX-License-Identifier: Apache-2.0
#

# Pre-requisites
CONFIG_REBOOT=y
CONFIG_FLASH=y
CONFIG_FLASH_MAP=y
CONFIG_IMG_MANAGER=y
CONFIG_STREAM_FLASH=y
CONFIG_NET_BUF=y
CONFIG_ZCBOR=y
CONFIG_MCUMGR=y
CONFIG_IMG_BLOCK_BUF_SIZE=4096
CONFIG_ENTROPY_DEVICE_RANDOM_GENERATOR=y
CONFIG_MAIN_STACK_SIZE=2048
#CONFIG_WATCHDOG=y

# Bluetooth configuration
CONFIG_BT=y
CONFIG_BT_PERIPHERAL=y
CONFIG_BT_PHY_UPDATE=n
CONFIG_BT_CTLR_TX_PWR_PLUS_4=y
CONFIG_BT_CTLR_LE_PING=n
CONFIG_BT_CTLR_DATA_LENGTH_MAX=251
CONFIG_BT_BUF_ACL_TX_SIZE=260
CONFIG_BT_BUF_ACL_RX_SIZE=260
CONFIG_BT_BUF_EVT_RX_SIZE=255
CONFIG_BT_BUF_EVT_DISCARDABLE_SIZE=255
CONFIG_BT_BUF_CMD_TX_SIZE=255

# MCUmgr configuration
CONFIG_MCUMGR_TRANSPORT_NETBUF_SIZE=4192
CONFIG_MCUMGR_TRANSPORT_BT=y
CONFIG_MCUMGR_TRANSPORT_BT_REASSEMBLY=y
CONFIG_MCUMGR_TRANSPORT_BT_CONN_PARAM_CONTROL=y
CONFIG_MCUMGR_TRANSPORT_BT_CONN_PARAM_CONTROL_LATENCY=2
CONFIG_MCUMGR_GRP_OS=y
CONFIG_MCUMGR_GRP_OS_ECHO=n
CONFIG_MCUMGR_GRP_OS_INFO=y
CONFIG_MCUMGR_GRP_OS_INFO_BUILD_DATE_TIME=y
CONFIG_MCUMGR_GRP_IMG=y
CONFIG_MCUMGR_GRP_IMG_ALLOW_ERASE_PENDING=y
CONFIG_MCUMGR_GRP_IMG_DIRECT_UPLOAD=y
CONFIG_MCUMGR_GRP_IMG_FRUGAL_LIST=y

# Sensor configuration
CONFIG_SENSOR=y
CONFIG_LIS2DH=n
CONFIG_SM351LT=n

# Enable checksums for crap quality sensors by a crap quality vendor to try and mitigate some of
# the potential issues with this sensor which is of absolute joke quality
CONFIG_SI7055_ENABLE_CHECKSUM=y
```

## src/main.c
```c
/*
 * Copyright (C) 2024 Jamie M.
 *
 * SPDX-License-Identifier: Apache-2.0
 */

#include <stdio.h>

int main(void)
{
}
```
